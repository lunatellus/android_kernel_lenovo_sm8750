## drivers/extcon/Kconfig
```kconfig
# SPDX-License-Identifier: GPL-2.0-only
#
# EXTCON drivers
#
# When adding new entries keep the list in alphabetical order

config EXTCON_QTI_SPMI_MISC
	tristate "Qualcomm USB extcon support"
	depends on ARCH_QCOM || COMPILE_TEST
	help
	  Say Y here to enable SPMI PMIC based USB cable detection
	  support on Qualcomm PMICs such as PM8941.

	  This driver provides USB ID and VBUS detection support through
	  the extcon framework. It handles USB host/device role switching
	  by monitoring the USB ID pin and VBUS line states.

	  To compile this driver as a module, choose M here: the
	  module will be called extcon-qti-spmi-misc.

config EXTCON_USB_GPIO
	tristate "USB GPIO extcon support"
	depends on GPIOLIB || COMPILE_TEST
	help
	  Say Y here to enable GPIO based USB cable detection extcon support.
	  Used typically if GPIO is used for USB ID pin detection.

	  To compile this driver as a module, choose M here: the
	  module will be called extcon-qti-spmi-misc.
```

## drivers/firmware/arm_ffa/Kconfig
```kconfig
# SPDX-License-Identifier: GPL-2.0-only
#
# For a description of the syntax of this configuration file,
# see Documentation/kbuild/kconfig-language.rst.
#

menu "Firmware Drivers"

source "$(KCONFIG_EXT_PREFIX)drivers/firmware/arm_scmi/Kconfig"
source "$(KCONFIG_EXT_PREFIX)drivers/firmware/qcom/Kconfig"

config ARM_FFA_TRANSPORT
	tristate "Arm Firmware Framework for Armv8-A"
	depends on OF
	depends on ARM64
	default n
	help
	  This Firmware Framework(FF) for Arm A-profile processors describes
	  interfaces that standardize communication between the various
	  software images which includes communication between images in
	  the Secure world and Normal world. It also leverages the
	  virtualization extension to isolate software images provided
	  by an ecosystem of vendors from each other.

	  This driver provides interface for all the client drivers making
	  use of the features offered by ARM FF-A.

config ARM_FFA_SMCCC
	bool
	default ARM_FFA_TRANSPORT
	depends on ARM64 && HAVE_ARM_SMCCC_DISCOVERY
endmenu
```

## drivers/firmware/qcom/Kconfig
```kconfig
# SPDX-License-Identifier: GPL-2.0-only
#
# For a description of the syntax of this configuration file,
# see Documentation/kbuild/kconfig-language.rst.
#

menu "Qualcomm firmware drivers"

config QCOM_SCM
	select QCOM_TZMEM
	tristate

config QCOM_TZMEM_FFA
	bool "QCOM TZMEM FFA support"
	depends on QCOM_TZMEM && ARM_FFA_TRANSPORT
	default n
	help
	  This option enables support for QCOM TZMEM FFA.

	  This feature config enable FFA support in qcom_tzmem driver.
	  Please note, FFA memory sharing is different aspect compared to older
	  older method of plugging feature via scm calls.
	  With this, traditional method of memory sharing will be replaced with
	  FFA based implementation.

config QCOM_TZMEM_LOW_MEMORY
	bool "Enable low memory mode for QCOM TZMEM"
	depends on QCOM_TZMEM
	default n
	help
	  This option enables low-memory behavior for qcom_tzmem users.
	  When enabled, smaller pool sizes are used in initialization
	  paths(like scm and shmbridge), and runtime fallback allocation from qcom_tzmem
	  is disabled once the pool memory is exhausted.

	  Say 'Y' here for low-memory targets (QTVM, for example).

config QTEE_SHM_BRIDGE
	bool "QTI TEE shared memory bridge"
	depends on QCOM_SCM && QCOM_TZMEM
	default y if QCOM_SCM
	help
	  QTEE shared memory bridge driver provides kernel APIs to share
	  memory between trustzone & other VMs through shared memory bridge.
	  It allows kernel clients to create bridge, delete bridge, and do
	  memory sub-allocation and free from the default kernel bridge
	  created by bridge driver.

config QCOM_SCM_DOWNLOAD_MODE_DEFAULT
	bool "Qualcomm download mode enabled by default"
	depends on QCOM_SCM
	help
	  A device with "download mode" enabled will upon an unexpected
	  warm-restart enter a special debug mode that allows the user to
	  "download" memory content over USB for offline postmortem analysis.
	  The feature can be enabled/disabled on the kernel command line.

	  Say Y here to enable "download mode" by default.

config QCOM_QSEECOM
	bool "Qualcomm QSEECOM interface driver"
	depends on QCOM_SCM=y
	select AUXILIARY_BUS
	help
	  Various Qualcomm SoCs have a Secure Execution Environment (SEE) running
	  in the Trust Zone. This module provides an interface to that via the
	  QSEECOM mechanism, using SCM calls.

	  The QSEECOM interface allows, among other things, access to applications
	  running in the SEE. An example of such an application is 'uefisecapp',
	  which is required to access UEFI variables on certain systems. If
	  selected, the interface will also attempt to detect and register client
	  devices for supported applications.

	  Select Y here to enable the QSEECOM interface driver.

config QCOM_QSEECOM_UEFISECAPP
	bool "Qualcomm SEE UEFI Secure App client driver"
	depends on QCOM_QSEECOM
	depends on EFI
	help
	  Various Qualcomm SoCs do not allow direct access to EFI variables.
	  Instead, these need to be accessed via the UEFI Secure Application
	  (uefisecapp), residing in the Secure Execution Environment (SEE).

	  This module provides a client driver for uefisecapp, installing efivar
	  operations to allow the kernel accessing EFI variables, and via that also
	  provide user-space with access to EFI variables via efivarfs.

	  Select Y here to provide access to EFI variables on the aforementioned
	  platforms.

config QCOM_SCM_SMCI
	tristate "Qualcomm SMC Invoke Support"
	depends on QCOM_SCM
	depends on QCOM_SI_CORE
	help
	  Various Qualcomm SoCs have a Trusted Execution Environment (TEE) running
	  in the Trust Zone. This module provides an interface to that via the
	  capability based object invocation, using SI-CORE.

	  Enable SCM_SMCI driver which supports capability based secure
	  communication between QTEE and VM. Using SCM_SMCI, kernel can
	  issue calls to QTEE or TAs to request a service or exposes services
	  to QTEE and TAs. The SCM_SMCI implements the necessary marshaling of
	  messages with QTEE.

config PKVM_SECURE_MEMORY_MANAGER
	tristate "PKVM SecureMemory Manager"
	help
	  This driver implements secure memory management for protected KVM
	  (pKVM) on Qualcomm platforms. It queries TrustZone for secure memory
	  region descriptors and loads an EL2 module to unmap those secure
	  regions from the Host stage-2 page tables, preventing host access to
	  hypervisor-protected memory.

source "$(KCONFIG_EXT_PREFIX)drivers/firmware/qcom/si_core/Kconfig"

endmenu
```

## drivers/gpu/drm/bridge/Kconfig
```kconfig
# SPDX-License-Identifier: GPL-2.0-only
config DRM_LT9611UXC
       tristate "Lontium LT9611UXC DSI/HDMI bridge"
       select SND_SOC_HDMI_CODEC if SND_SOC
       depends on OF
       select DRM_PANEL_BRIDGE
       select DRM_KMS_HELPER
       select DRM_MIPI_DSI
       select REGMAP_I2C
       help
         Driver for Lontium LT9611UXC DSI to HDMI bridge
         chip driver that converts dual DSI and I2S to
         HDMI signals
         please say Y if you have such hardware.

config DRM_AUX_BRIDGE
       tristate
       depends on DRM_BRIDGE && OF
       select AUXILIARY_BUS
       select DRM_PANEL_BRIDGE
       help
         Simple transparent bridge that is used by several non-DRM drivers to
         build bridges chain.
```

## drivers/iio/dac/Kconfig
```kconfig
# SPDX-License-Identifier: GPL-2.0-only
#
# DAC drivers
#
# When adding new entries keep the list in alphabetical order

menu "Digital to analog converters"

config QCOM_SPMI_VDAC
	tristate "QCOM SPMI VDAC driver"
	depends on SPMI
	help
	  This is the IIO based PMIC Dual-push-pull (DPPD) voltage based
	  Digital to Analog Converter driver for Qualcomm Technologies Inc.
	  This driver supports to set DAC voltage and read back from the
	  ATEST1 and ATEST2 VADC channels.

	  To compile this driver as a module, choose M here: the module will be
	  called qcom-spmi-vdac
endmenu
```

## drivers/input/touchscreen/Kconfig
```kconfig
# SPDX-License-Identifier: GPL-2.0-only
#
# Input misc drivers configuration
#

config TOUCHSCREEN_CAP1296
        tristate "touch driver for cap1296"
        help
          The CAP1296 is a multiple channel capacitive touch
          sensor controller. It contains six (6) individual capaci-
          tive touch sensor inputs with programmable sensitivity
          for use in touch sensor applications.
```
