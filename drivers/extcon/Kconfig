## drivers/net/usb/Kconfig
```kconfig
# SPDX-License-Identifier: GPL-2.0-only

config HQ_USBNET
	tristate "Huaqin USB networking framework"
	depends on USB_USBNET
	select HQ_MII
	help
	  Huaqin copy of the usbnet framework used by the Lenovo smsc95xx
	  driver. The module is called hq_usbnet.

config USB_NET_SMSC95XX
	tristate "SMSC LAN95XX based USB 2.0 10/100 ethernet devices"
	depends on USB_USBNET && HQ_USBNET && HQ_KALLSYMS
	select PHYLIB
	select HQ_SMSC_PHY
	select BITREVERSE
	select CRC16
	select CRC32
	imply NET_SELFTESTS
	help
	  Lenovo Huaqin variant of the SMSC LAN95XX USB Ethernet driver.
	  Uses hq_usbnet, hq_mii and hq_smsc with the stock module names.
```

## drivers/nvmem/layouts/Kconfig
```kconfig
# SPDX-License-Identifier: GPL-2.0

menu "Layout Types"

config NVMEM_LAYOUT_QCOM_ETH_MAC
	tristate "Qualcomm Ethernet MAC address layout"
	depends on OF
	help
	  Handles the non-contiguous eFuse storage of eth MAC byte[5]
	  on Qualcomm SoC. Provides transparent post-processing for
	  the ethx-mac nvmem cell.

	  Say Y if you use the SA8797P SoC with Ethernet.

config NVMEM_LAYOUT_U_BOOT_ENV
	tristate "U-Boot environment variables layout"
	select CRC32
	select GENERIC_NET_UTILS
	help
	  U-Boot stores its setup as environment variables. This driver adds
	  support for verifying & exporting such data. It also exposes variables
	  as NVMEM cells so they can be referenced by other drivers.

	  If unsure, say N.

endmenu
```

## drivers/perf/Kconfig
```kconfig
# SPDX-License-Identifier: GPL-2.0-only
#
# Performance Monitor Drivers
#

menu "Performance monitor support"
	depends on PERF_EVENTS

config QCOM_LLCC_PMU
	tristate "Qualcomm Technologies LLCC PMU"
	depends on ARCH_QCOM && ARM64
	help
	   Provides support for the LLCC performance monitor unit (PMU) in
	   Qualcomm Technologies processors.
	   Adds the LLCC PMU into the perf events subsystem for monitoring
	   LLCC miss events.

config ARM_SMMU_PMU
        tristate "ARM SMMU PMU"
        depends on PERF_EVENTS && ARM64 && ARM_SMMU
          help
          Provides support for the SMMU performance monitor unit (PMU)
          on ARM-based systems.
          Adds the SMMU PMU into the perf events subsystem for
          monitoring SMMU performance events.

config MSM_DWC_PCIE_PMU
	tristate "Synopsys DesignWare PCIe PMU"
	depends on PCI
	help
	  Enable perf support for the Synopsys DesignWare PCIe Performance
	  Monitoring Unit (PMU). This driver exposes per-Root-Port hardware
	  counters for PCIe throughput and error metrics via the Linux perf
	  subsystem. Supported on platforms using DesignWare PCIe IP,
	  including the Alibaba Yitian 710 SoC. Say Y or M here to enable
	  PCIe PMU event monitoring via perf stat/perf record.

endmenu
```

## drivers/phy/Kconfig
```kconfig
# SPDX-License-Identifier: GPL-2.0-only
#
# Phy drivers for Qualcomm and Atheros platforms
#

config PHY_NXP_PTN3222
        tristate "NXP PTN3222 1-port eUSB2 to USB2 redriver"
        depends on I2C
        depends on OF
        select GENERIC_PHY
        help
          Enable this to support NXP PTN3222 1-port eUSB2 to USB2 Redriver.
          This redriver performs translation between eUSB2 and USB2 signalling
          schemes. It supports all three USB 2.0 data rates: Low Speed, Full
          Speed and High Speed.
```

## drivers/power/supply/Kconfig
```kconfig
# SPDX-License-Identifier: GPL-2.0-only
if POWER_SUPPLY

config QTI_BATTERY_CHARGER
	tristate "QTI Glink battery charger"
	depends on QTI_PMIC_GLINK && EXTCON && TYPEC
	help
	  Say Y here to enable Qualcomm Technologies, Inc. battery charger
	  driver which interfaces with the charger firmware running on the
	  remote subsystem (e.g. DSP) by communicating over PMIC Glink channel
	  and provides information about the battery, USB and wireless charging
	  by exposing them as power supply devices.

	  To compile the driver as a module, choose M here: the module will be
	  called qti_battery_charger.

config CHARGER_QCOM_SMBB
	tristate "Qualcomm Switch-Mode Battery Charger and Boost"
	depends on MFD_SPMI_PMIC || COMPILE_TEST
	depends on OF
	depends on EXTCON
	depends on REGULATOR
	help
	  Say Y to include support for the Switch-Mode Battery Charger and
	  Boost (SMBB) hardware found in Qualcomm PM8941 PMICs.  The charger
	  is an integrated, single-cell lithium-ion battery charger.  DT
	  configuration is required for loading, see the devicetree
	  documentation for more detail.  The base name for this driver is
	  'pm8941_charger'.

config BATTERY_MAX1720X
	tristate "Maxim MAX17201/MAX17215 Fuel Gauge"
	depends on I2C
	select REGMAP_I2C
	help
	  MAX1720x is fuel-gauge systems for lithium-ion (Li+) batteries
	  in handheld and portable equipment.

	  Say Y here to enable support for the MAX17201/MAX17335 standalone
	  battery gas-gauge.

config QTI_CHARGER_NFC_VREG
	bool "Allow client to vote on Charger reverse boost regulator"
	depends on QTI_BATTERY_CHARGER
	help
	  Say 'y' here to allow client drivers to enable and perform voltage
	  get/set operations via the regulator framework on the charger reverse
	  boost regulator. This may be used by client drivers such as NFC
	  to manage their power supply requirements through the charger’s
	  reverse boost regulator.

source "$(KCONFIG_EXT_PREFIX)drivers/power/supply/qcom/Kconfig"

endif # POWER_SUPPLY
```

## drivers/ptp/Kconfig
```kconfig
# SPDX-License-Identifier: GPL-2.0-only
#
# PTP clock support configuration
#

menu "PTP clock support"

config PTP_QCOM_CLOCK_TSC_VM
	tristate "QCOM TSC virtual PTP clock"
	help
	  This driver adds support for reading the TSC timestamp using the
	  PTP clock gettime operation on a virtual machine(VM).

	  To compile this driver as a module, choose M here: the module
	  will be called ptp_qcom_tsc_vm.

endmenu
```

## drivers/pwm/Kconfig
```kconfig
# SPDX-License-Identifier: GPL-2.0-only
if PWM

config PWM_QCOM
	tristate "Qualcomm Technologies, Inc. PWM support"
	depends on ARCH_QCOM
	help
	  Generic PWM framework driver for the PWM controller found on
	  Qualcomm Technologies Inc. SoCs.

	  To compile this driver as a module, choose M here: the module
	  will be called pwm-qcom.

endif
```

## drivers/rtc/Kconfig
```kconfig
# SPDX-License-Identifier: GPL-2.0

config RTC_QTI_GLINK
	tristate "QTI Glink RTC"
	depends on RTC_CLASS && QTI_PMIC_GLINK
	help
	  Say Y here to enable the Qualcomm Technologies, Inc. RTC driver
	  for platforms where direct SPMI access to PMIC RTC hardware is
	  restricted.

	  On these platforms (such as Hamoa), the RTC hardware permissions
	  are managed by a remote processor that handles the TAD (Time and
	  Alarm Device) feature. This driver acts as a proxy, communicating
	  over PMIC Glink to query time and program alarms, allowing the
	  RTC to wake up or interrupt the APPS subsystem.

	  To compile the driver as a module, choose M here: the module will be
	  called rtc_qti_glink.
```

## drivers/thermal/Kconfig
```kconfig
# SPDX-License-Identifier: GPL-2.0-only
source "$(KCONFIG_EXT_PREFIX)drivers/thermal/lenovo/Kconfig"
```

## drivers/thermal/lenovo/Kconfig
```kconfig
# SPDX-License-Identifier: GPL-2.0-only
menu "Lenovo thermal drivers"

config LENOVO_SYS_TEMP
	tristate "Lenovo virtual thermal zones"
	depends on THERMAL_OF && HQ_SYSFS
	help
	  Registers virtual thermal zones whose temperatures are computed from
	  other thermal zones by a fixed model described in the device tree
	  ("lenovo,sys-temp").

	  To compile this driver as a module, choose M here: the module will be
	  called lenovo_sys_temp.

config LENOVO_THERMAL_CONTROL
	tristate "Lenovo thermal control sysfs node"
	help
	  Creates the /sys/devices/system/cpu/cpu0/thermal/control node used by
	  the Lenovo thermal userspace.

	  To compile this driver as a module, choose M here: the module will be
	  called lenovo_thermal_control.

endmenu
```

## drivers/tty/serial/Kconfig
```kconfig
# SPDX-License-Identifier: GPL-2.0
#
# Serial device configuration
#

menu "Serial drivers"
	depends on HAS_IOMEM

comment "Non-8250 serial port support"

config SERIAL_MSM_GENI
    tristate "MSM on-chip GENI HW based serial port support"
    depends on ARCH_QCOM
    depends on QCOM_GENI_SE

config SERIAL_QCOM_GENI_MSM
	tristate "QCOM on-chip GENI based serial port support with SCMI"
	depends on ARCH_QCOM || COMPILE_TEST
	depends on QCOM_GENI_SE_MSM
	select SERIAL_CORE
	help
	  This driver supports GENI serial engine based Serial controller
	  on the Qualcomm Technologies Inc.'s SoCs. If you say yes to this
	  option, support will be included for the built-in Serial
	  interface on the Qualcomm Technologies Inc.'s SoCs.

	  This driver can also be built as a module.  If so, the module
	  will be called qcom_geni_serial_msm.

config SERIAL_PKVM_GENI
	tristate "Protected KVM GENI UART"
	depends on ARM64
	depends on KVM
	select SERIAL_CORE
	help
	  This driver provides UART support for protected KVM (pKVM) at EL2
	  (Exception Level 2) on Qualcomm Technologies Inc. SoCs with GENI
	  serial engines. It enables serial console output from the hypervisor
	  running in protected mode, which is useful for debugging and logging
	  purposes in virtualized environments.

	  If you are using pKVM on Qualcomm platforms and need hypervisor-level
	  UART functionality, say Y or M here.

endmenu
```

## drivers/usb/typec/mux/Kconfig
```kconfig
# SPDX-License-Identifier: GPL-2.0-only
#
# Type-C mux drivers
#

config TYPEC_MUX_PS883X
	tristate "Parade PS883x Type-C retimer driver"
	depends on I2C
	depends on DRM || DRM=n
	select DRM_AUX_BRIDGE if DRM_BRIDGE && OF
	select REGMAP_I2C
	help
	  Say Y or M if your system has a Parade PS883x Type-C retimer chip
	  found on some devices with a Type-C port.
```

## kernel/sched/lenovohypersched/Kconfig
```kconfig
# SPDX-License-Identifier: GPL-2.0-only

config LENOVO_HYPERSCHED
	tristate "Lenovo hyper scheduler"
	depends on SMP && ANDROID_VENDOR_HOOKS && ANDROID_VENDOR_OEM_DATA
	help
	  Lenovo task boosting and UX scheduling extensions built on Android
	  scheduler vendor hooks. Controlled through /proc/lenovo_hyperschedule.

	  To compile this driver as a module, choose M here: the module will be
	  called lenovohyperSched.
```
