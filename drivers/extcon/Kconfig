## drivers/iommu/Kconfig
```kconfig
# SPDX-License-Identifier: GPL-2.0-only
# The IOVA library may also be used by non-IOMMU_API users
# IOMMU_API always gets selected by whoever wants it.
if IOMMU_SUPPORT

menu "Generic IOMMU Pagetable Support"

# Selected by the actual pagetable implementations
config IOMMU_IO_PGTABLE
	bool

config IOMMU_IO_PGTABLE_LPAE
	bool "ARMv7/v8 Long Descriptor Format"
	select IOMMU_IO_PGTABLE
	depends on ARM || ARM64 || COMPILE_TEST
	depends on !GENERIC_ATOMIC64	# for cmpxchg64()
	help
	  Enable support for the ARM long descriptor pagetable format.
	  This allocator supports 4K/2M/1G, 16K/32M and 64K/512M page
	  sizes at both stage-1 and stage-2, as well as address spaces
	  up to 48-bits in size.

config IOMMU_IO_PGTABLE_LPAE_SELFTEST
	bool "LPAE selftests"
	depends on IOMMU_IO_PGTABLE_LPAE
	help
	  Enable self-tests for LPAE page table allocator. This performs
	  a series of page-table consistency checks during boot.

	  If unsure, say N here.

config IOMMU_IO_PGTABLE_CONTIG_HINT
	bool "Enable contig hint"
	depends on IOMMU_IO_PGTABLE_LPAE
	help
	  Enable config hint for LPAE page table allocator. This would
	  allow multiple TLB entries to be combined into a single entry
	  which optimizes TLB lookups.

	  If unsure, say N here.

config IOMMU_IO_PGTABLE_FAST
	bool "Fast ARMv7/v8 Long Descriptor Format"
	depends on (ARM || ARM64) && IOMMU_DMA
	help
          Enable support for a subset of the ARM long descriptor pagetable
	  format.  This allocator achieves fast performance by
	  pre-allocating and pre-populating page table memory up front.
	  only supports a 32 bit virtual address space.

          This implementation is mainly optimized for use cases where the
          buffers are small (<= 64K) since it only supports 4K page sizes.

endmenu

# ARM IOMMU support
config ARM_SMMU
	tristate "ARM Ltd. System MMU (SMMU) Support"
	depends on ARM64 || ARM || COMPILE_TEST
	depends on !GENERIC_ATOMIC64	# for IOMMU_IO_PGTABLE_LPAE
	select IOMMU_API
	select IOMMU_IO_PGTABLE_LPAE
	select ARM_DMA_USE_IOMMU if ARM
	help
	  Support for implementations of the ARM System MMU architecture
	  versions 1 and 2.

	  Say Y here if your SoC includes an IOMMU device implementing
	  the ARM SMMU architecture.

config ARM_SMMU_LEGACY_DT_BINDINGS
	bool "Support the legacy \"mmu-masters\" devicetree bindings"
	depends on ARM_SMMU=y && OF
	help
	  Support for the badly designed and deprecated "mmu-masters"
	  devicetree bindings. This allows some DMA masters to attach
	  to the SMMU but does not provide any support via the DMA API.
	  If you're lucky, you might be able to get VFIO up and running.

	  If you say Y here then you'll make me very sad. Instead, say N
	  and move your firmware to the utopian future that was 2016.

config ARM_SMMU_DISABLE_BYPASS_BY_DEFAULT
	bool "Default to disabling bypass on ARM SMMU v1 and v2"
	depends on ARM_SMMU
	default y
	help
	  Say Y here to (by default) disable bypass streams such that
	  incoming transactions from devices that are not attached to
	  an iommu domain will report an abort back to the device and
	  will not be allowed to pass through the SMMU.

	  Any old kernels that existed before this KConfig was
	  introduced would default to _allowing_ bypass (AKA the
	  equivalent of NO for this config).  However the default for
	  this option is YES because the old behavior is insecure.

	  There are few reasons to allow unmatched stream bypass, and
	  even fewer good ones.  If saying YES here breaks your board
	  you should work on fixing your board.  This KConfig option
	  is expected to be removed in the future and we'll simply
	  hardcode the bypass disable in the code.

	  NOTE: the kernel command line parameter
	  'arm-smmu.disable_bypass' will continue to override this
	  config.

config ARM_SMMU_QCOM
	def_tristate y
	depends on ARM_SMMU && ARCH_QCOM
	select QCOM_SCM
	help
	  When running on a Qualcomm platform that has the custom variant
	  of the ARM SMMU, this needs to be built into the SMMU driver.

config ARM_SMMU_QCOM_DEBUG
	bool "ARM SMMU QCOM implementation defined debug support"
	depends on ARM_SMMU_QCOM=y
	help
	  Support for implementation specific debug features in ARM SMMU
	  hardware found in QTI platforms. This include support for
	  the Translation Buffer Units (TBU) that can be used to obtain
	  additional information when debugging memory management issues
	  like context faults.

	  Say Y here to enable debug for issues such as context faults
	  or TLB sync timeouts which requires implementation defined
	  register dumps.

config QTI_IOMMU_SUPPORT
	tristate "Support for QTI iommu drivers"
	help
	  The QTI GPU device may switch between multiple iommu domains,
	  depending on usecase. This introduces a need to track all such
	  domains in a non-driver specific manner.
	  If in doubt say N.

config QCOM_IOMMU_UTIL
	tristate "Support for qcom additions to the iommu framework"
	help
	  QCOM iommu drivers support a general set of functionality in
	  addition to the functions provided by the iommu framework.
	  This includes devicetree properties for configuring iommu
	  groups and iova ranges.

	  Say N here if unsure.

config QCOM_IOMMU_DEBUG
	tristate "IOMMU debugging and testing"
	depends on QCOM_IOMMU_UTIL
	depends on DEBUG_FS
	help
	  This option is used to enable profiling and debugging in
	  the IOMMU framework code. IOMMU profiling and debugging
	  can be done through the debugfs nodes which this option
	  makes available.

config ARM_SMMU_SELFTEST
	bool "ARM SMMU self test support"
	depends on ARM_SMMU
	help
	  Enables self tests for arm smmu. Tests basic hardware
	  configurations like interrupts. Note that enabling this
	  option can marginally increase the boot time.

	  If unsure, say N.

config IOMMU_TLBSYNC_DEBUG
	bool "TLB sync timeout debug"
	depends on ARM_SMMU
	help
	  Collects the SMMU system state information after the
	  first TLB sync timeout failure by calling BUG() from
	  a workqueue thread. Note to use this only on debug
	  builds.

	  If unsure, say N here.

config QCOM_LAZY_MAPPING
	tristate "Reference counted iommu-mapping support"
	depends on QCOM_DMABUF_HEAPS
	depends on IOMMU_API
	help
	  DMA-BUFs may be shared between several software clients.
	  Reference counting the mapping may simplify coordination between
	  these clients, and decrease latency by preventing multiple
	  map/unmaps of the same region.

	  If unsure, say N here.

config ARM_SMMU_NVIDIA
	tristate "NVIDIA Tegra SMMU implementation"
	depends on ARM_SMMU && TEGRA_MC
	help
	  Support for NVIDIA Tegra SoC specific SMMU implementation.
	  This enables the NVIDIA specific ARM SMMU implementation
	  which is required for Tegra186, Tegra194, and Tegra234 SoCs.

	  Say M here if you are building for an NVIDIA Tegra platform
	  that uses ARM SMMU.

config ARM_SMMU_V3
        tristate "ARM Ltd. System MMU Version 3 (SMMUv3) Support"
        depends on ARM64
        select IOMMU_API
        select IOMMU_IO_PGTABLE_LPAE
        select GENERIC_MSI_IRQ_DOMAIN
        help
          Support for implementations of the ARM System MMU architecture
          version 3 providing translation support to a PCIe root complex.

          Say Y here if your system includes an IOMMU device implementing
          the ARM SMMUv3 architecture.

config ARM_PARAVIRT_SMMU_V3
        tristate "Paravirtualized ARM SMMU V3 driver support"
        depends on ARM64
        depends on QCOM_SCM
        select IOMMU_API
        select IOMMU_IO_PGTABLE_LPAE
        select GENERIC_MSI_IRQ_DOMAIN
        help
          Support for a paravirtualized implementation of ARM SMMU V3
          architecture.

          Say Y here if your system has the corresponding backend
          SMMU-v3 support available which runs at a higher exception
          level.

config ARM_SMMU_V3_SVA
        bool "Shared Virtual Addressing support for the ARM SMMUv3"
        depends on ARM_SMMU_V3
        select IOMMU_SVA
        select MMU_NOTIFIER
        help
          Support for sharing process address spaces with devices using the
          SMMUv3.

          Say Y here if your system supports SVA extensions such as PCIe PASID
          and PRI.

config ARM_SMMU_V3_QCOM_VIRTIO
        bool "Virtio-Iommu ARM-SMMU-V3 acceleration"
        depends on ARM_SMMU_V3 && VIRTIO_IOMMU
        help
          The virtio-iommu attach-table extension allows the VM to program
          S1 pagetables directly, reducing the number of host-to-VM
          transitions. Enable awareness of arm-smmu-v3 register settings,
          pagetable formats, and tlb maintenance operations by virtio-iommu.
          If unsure, say N here.

config VIRTIO_IOMMU
        tristate "Virtio IOMMU driver"
        depends on VIRTIO
        depends on (ARM64 || X86)
        select IOMMU_API
        select INTERVAL_TREE
        select ACPI_VIOT if ACPI
        help
          Enable support for the Virtio IOMMU device, a paravirtualized IOMMU
          that manages DMA from endpoints in virtualized environments. The device
          can act as a proxy for physical IOMMUs (for assigned devices) or as a
          purely virtual IOMMU for emulated/paravirtualized endpoints.

          Say Y here if you intend to run this kernel as a guest.

config QCOM_SMMU_IRGN0_ERRATA
	bool "IRGN0 errata"
	depends on QCOM_IOMMU_UTIL
	depends on ARCH_SERAPH
        help
	  This option is used to apply a work around for
	  an internal errata to adjust the irgn bit.

	  Say N here if unsure.

config QCOM_SMMU_V2_V3_DISPATCHER
       tristate "SMMUv2/3 nesting support in pKVM"
       default m
       help
         When enabled, pKVM will implement SMMUv2/3 nesting emulating the host access to
         command queue and STEs and attach a stage-2 page table to match the host page
         table, this allows pKVM to be enabled while using the kernel driver for SMMUv2/3
         instead of the pKVM driver.

endif # IOMMU_SUPPORT
```

## drivers/leds/Kconfig
```kconfig
# SPDX-License-Identifier: GPL-2.0-only
# This library does not depend on NEW_LEDS and must be independent so it can be
# selected from other subsystems (specifically backlight).
if NEW_LEDS

comment "LED drivers"

config LEDS_QTI_FLASH
	tristate "Support for QTI Flash LEDs"
	depends on LEDS_CLASS_FLASH
	depends on MFD_SPMI_PMIC
	select LEDS_TRIGGERS
	help
	  This driver supports flash LED peripheral that is present on
	  some Qualcomm Technologies, Inc. PMICs (e.g. PM8350C).  It can
	  configure the flash LED target current for several independent
	  channels. It also supports various over current and over
	  temperature mitigation features.

	  To compile this driver as a module, choose M here: the
	  module will be called leds-qti-flash.

config LEDS_QPNP_VIBRATOR_LDO
        tristate "Vibrator-LDO support for QPNP PMIC"
        depends on LEDS_CLASS && MFD_SPMI_PMIC
        help
          This option enables device driver support for the vibrator-ldo
          peripheral found on Qualcomm Technologies, Inc. QPNP PMICs.
          The vibrator-ldo peripheral is capable of driving ERM vibrators.

          To compile this driver as a module, choose M here: the module
          will be called leds-qpnp-vibrator-ldo.

config LEDS_AW2016
	tristate "LED Support for AW2016"
	depends on LEDS_CLASS && I2C
	help
	  this option enables support for the AW2016 RGB LED connected
	  through I2C. Say Y to enable support for the AW2016 LED.

	  To compile this driver as a module, choose M here: the module
	  will be called leds-aw2016.

config LEDS_USER_AW21104
	tristate "LED Support for AW21104"
	depends on LEDS_CLASS && I2C
	help
	  this option enables support for the AW21104 RGBW LED connected
	  through I2C facing user(wearer) . Say Y to enable support for the AW21104 LED.

	  To compile this driver as a module, choose M here: the module
	  will be called leds-user-aw21104.

config LEDS_BYS_AW21104
	tristate "LED Support for AW21104"
	depends on LEDS_CLASS && I2C
	help
	  this option enables support for the AW21104 RGBW LED connected
	  through I2C facing bystander. Say Y to enable support for the AW21104 LED.

	  To compile this driver as a module, choose M here: the module
	  will be called leds-bys-aw21104.

config LEDS_USER_LP5814
	tristate "LED Support for LP5814"
	depends on LEDS_CLASS && I2C
	help
	  this option enables support for the LP5814 RGBW LED connected
	  through I2C facing user(wearer) . Say Y to enable support for the LP5814 LED.

	  To compile this driver as a module, choose M here: the module
	  will be called leds-user-lp5814.

config LEDS_ETIRLED_LM3645
	tristate "LED Support for LM3645"
	depends on LEDS_CLASS && I2C
	help
	  this option enables support for the LM3645 IR LED connected
	  through I2C for the ET camera sensor. Say Y to enable support for the LP5814 LED.

	  To compile this driver as a module, choose M here: the module
	  will be called leds-etirled-lm3645.

endif # NEW_LEDS
```

## drivers/misc/hq/Kconfig
```kconfig
# SPDX-License-Identifier: GPL-2.0-only
menu "Huaqin device drivers"

config HQ_SYSFS
	tristate "Huaqin hardware information sysfs"
	depends on SCSI_UFSHCD && GPIOLIB && THERMAL
	help
	  Publishes per-component hardware names below
	  /sys/class/hardinfo/interface/hardware_info/ and exports
	  hq_regiser_hw_info() for vendor drivers to register them.

	  To compile this driver as a module, choose M here: the module will be
	  called hqsysfs.

config HQ_KALLSYMS
	tristate "Huaqin kallsyms helper"
	depends on KPROBES && OF
	help
	  Exports hq_kallsyms_lookup_name() to vendor modules, resolving
	  kallsyms_lookup_name() through a kprobe because GKI does not export it.

	  To compile this driver as a module, choose M here: the module will be
	  called hq_kallsyms.

config HQ_UFSFFU
	tristate "Huaqin UFS field firmware update"
	depends on SCSI_UFSHCD
	help
	  Loads an OEM UFS firmware table and performs UFS field firmware
	  updates (FFU) with SCSI WRITE BUFFER commands for matching devices.

	  To compile this driver as a module, choose M here: the module will be
	  called ufsffu.

config HQ_EXTEND_RECLAIM
	tristate "Extended global page reclaim interface"
	depends on MEMCG && ANDROID_VENDOR_HOOKS
	help
	  Provides a sysfs interface to trigger global page reclaim from
	  userspace.

	  To compile this driver as a module, choose M here: the module will be
	  called extend_reclaim.

config HQ_REGISTER_DUMPER
	tristate "Huaqin regmap register dumper"
	depends on HQ_KALLSYMS && KPROBES && REGMAP && PROC_FS && ARM64
	help
	  Provides procfs nodes to dump registers of regmap-backed devices for
	  debugging.

	  To compile this driver as a module, choose M here: the module will be
	  called register_dumper.

config HQ_MAGIC_KEY
	tristate "Huaqin magic key debug trigger"
	depends on INPUT && SCHED_INFO
	help
	  Watches a key sequence on input devices and, when it completes,
	  either triggers a panic or dumps uninterruptible tasks for debugging.

	  To compile this driver as a module, choose M here: the module will be
	  called magic_key.

endmenu
```

## drivers/net/mdio_fe/Kconfig
```kconfig
# SPDX-License-Identifier: GPL-2.0-only

config EMAC_MDIO_FE
       tristate "Support for the mdio front end driver"
       help
         Adding support for EMAC MDIO Front end driver. This enables single
         mdio for the dual mac feature support on HQX. The front end driver
         get request from GVM and send it to the Backend mdio driver.The
         request is handled on the backend for the mdio read/write operation.
```

## drivers/net/phy/Kconfig
```kconfig
# SPDX-License-Identifier: GPL-2.0-only
#
# PHY Layer Configuration
#

source "$(KCONFIG_EXT_PREFIX)drivers/net/phy/aquantia/Kconfig"

config DP83867_PHY
	tristate "Texas Instruments DP83867 Gigabit PHY"
	help
	  Currently supports the DP83867 PHY.
```
