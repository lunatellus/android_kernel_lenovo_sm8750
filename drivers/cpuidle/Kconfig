## drivers/cpuidle/Kconfig
```kconfig
# SPDX-License-Identifier: GPL-2.0-only
menu "CPU Idle"

if CPU_IDLE

config CPU_IDLE_GOV_QCOM_LPM
    tristate "Qualcomm Technologies, Inc. CPU and Cluster governor"
    depends on ARCH_QCOM
    depends on ARM_PSCI_CPUIDLE
    help
      This governor implements effective cpu and cluster idle state
      selection with help of scheduler inputs, cpu idle state prediction
      and cluster idle state prediction algorithms.

      The predicted sleep time, latency requirement for the
      CPU and the idle state chosen based on the parameters are all
      logged in the trace.

config CPU_IDLE_SIMPLE_GOV_QCOM_LPM
    tristate "Qualcomm Technologies, Inc. CPU and Cluster simple governor"
    depends on ARCH_QCOM
    depends on ARM_PSCI_CPUIDLE
    help
      This governor allows the cpu and cluster to deeper idle states more aggressively
      by reducing cpuidle parameters such as the entry, exit latencies and the residency.
      This provides the provision to user to update cpuidle parameters so that it can
      allow or restrict particular Idle state more aggressively.

endif

endmenu
```

## drivers/mailbox/Kconfig
```kconfig
# SPDX-License-Identifier: GPL-2.0-only

if MAILBOX

config QCOM_IPCC
	tristate "Qualcomm Technologies, Inc. IPCC driver"
	depends on ARCH_QCOM || COMPILE_TEST
	help
	  Qualcomm Technologies, Inc. Inter-Processor Communication Controller
	  (IPCC) driver for MSM devices. The driver provides mailbox support for
	  sending interrupts to the clients. On the other hand, the driver also
	  acts as an interrupt controller for receiving interrupts from clients.
	  Say Y here if you want to build this driver.

config MSM_QMP
	tristate "QTI Mailbox Protocol(QMP)"
	help
	  Say yes to add support for the QTI Mailbox Protocol mailbox driver.
	  QMP is a lightweight communication protocol for sending messages to
	  a remote processor. This protocol fits into the Generic Mailbox
	  Framework. QMP uses a mailbox located in shared memory.

config QCOM_APCS_IPC
	tristate "Qualcomm APCS IPC driver"
	depends on ARCH_QCOM || COMPILE_TEST
	help
	  Qualcomm Technologies, Inc. APCS IPC mailbox driver.
	  The driver providing an interface for invoking the inter-process communication
	  signals from the application processor to other masters.
	  Say Y here if you want to build this driver.

endif
```

## net/Kconfig
```kconfig
# SPDX-License-Identifier: GPL-2.0-only
#
# Network configuration
#

if NET

menu "Networking options"

source "$(KCONFIG_EXT_PREFIX)net/qrtr/Kconfig"
source "$(KCONFIG_EXT_PREFIX)net/qmsgq/Kconfig"

endmenu

endif   # if NET

menuconfig NET_SCHED
	bool "QoS and/or fair queueing"
	select NET_SCH_FIFO
	help
	  When the kernel has several packets to send out over a network
	  device, it has to decide which ones to send first, which ones to
	  delay, and which ones to drop. This is the job of the queueing
	  disciplines, several different algorithms for how to do this
	  "fairly" have been proposed.

	  If you say N here, you will get the standard packet scheduler, which
	  is a FIFO (first come, first served). If you say Y here, you will be
	  able to choose from among several alternative algorithms which can
	  then be attached to different network devices. This is useful for
	  example if some of your network devices are real time devices that
	  need a certain minimum data flow rate, or if you need to limit the
	  maximum data flow rate for traffic which matches specified criteria.
	  This code is considered to be experimental.

	  To administer these schedulers, you'll need the user-level utilities
	  from the package iproute2+tc at
	  <https://www.kernel.org/pub/linux/utils/net/iproute2/>.  That package
	  also contains some documentation; for more, check out
	  <http://www.linuxfoundation.org/collaborate/workgroups/networking/iproute2>.

	  This Quality of Service (QoS) support will enable you to use
	  Differentiated Services (diffserv) and Resource Reservation Protocol
	  (RSVP) on your Linux router if you also say Y to the corresponding
	  classifiers below.  Documentation and software is at
	  <http://diffserv.sourceforge.net/>.

	  If you say Y here and to "/proc file system" below, you will be able
	  to read status information about packet schedulers from the file
	  /proc/net/psched.

	  The available schedulers are listed in the following questions; you
	  can say Y to as many as you like. If unsure, say N now.

if NET_SCHED

source "$(KCONFIG_EXT_PREFIX)net/sched/Kconfig"

endif # NET_SCHED
```

## net/sched/Kconfig
```kconfig
# SPDX-License-Identifier: GPL-2.0-only
#
# Traffic control configuration.
#

menu "NET_SCHED"

config NET_SCH_MQPRIO
	tristate "Multi-queue priority scheduler (MQPRIO)"
	help
	  Say Y here if you want to use the Multi-queue Priority scheduler.
	  This scheduler allows QOS to be offloaded on NICs that have support
	  for offloading QOS schedulers.

	  To compile this driver as a module, choose M here: the module will
	  be called sch_mqprio.

	  If unsure, say N

config NET_SCH_CBS
	tristate "Credit Based Shaper (CBS)"
	help
	  Say Y here if you want to use the Credit Based Shaper (CBS) packet
	  scheduling algorithm.

	  See the top of <file:net/sched/sch_cbs.c> for more details.

	  To compile this code as a module, choose M here: the
	  module will be called sch_cbs.

config NET_CLS_FLOWER
	tristate "Flower classifier"
	select NET_CLS
	help
	  If you say Y here, you will be able to classify packets based on
	  a configurable combination of packet keys and masks.

	  To compile this code as a module, choose M here: the module will
	  be called cls_flower.

config NET_SCH_ETF
	tristate "Earliest TxTime First (ETF)"
	help
	  Say Y here if you want to use the Earliest TxTime First (ETF) packet
	  scheduling algorithm.

	  See the top of <file:net/sched/sch_etf.c> for more details.

	  To compile this code as a module, choose M here: the
	  module will be called sch_etf.

config NET_ACT_GACT
	tristate "Generic actions"
	depends on NET_CLS_ACT
	help
	  Say Y here to take generic actions such as dropping and
	  accepting packets.

	  To compile this code as a module, choose M here: the
	  module will be called act_gact.

config NET_SCH_INGRESS
	tristate "Ingress/classifier-action Qdisc"
	depends on NET_CLS_ACT
	select NET_XGRESS
	help
	  Say Y here if you want to use classifiers for incoming and/or outgoing
	  packets. This qdisc doesn't do anything else besides running classifiers,
	  which can also have actions attached to them. In case of outgoing packets,
	  classifiers that this qdisc holds are executed in the transmit path
	  before real enqueuing to an egress qdisc happens.

	  If unsure, say Y.

	  To compile this code as a module, choose M here: the module will be
	  called sch_ingress with alias of sch_clsact.

endmenu
```
